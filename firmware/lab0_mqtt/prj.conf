## Kconfig
```
mainmenu "Lab 0 - Minimal IoT Implementation (MQTT)"

config LAB_WIFI_SSID
	string "Wi-Fi SSID"
	default "changeme"
	help
	  Name of the 2.4 GHz network the node joins. The ESP32-C6 radio does
	  not associate with 5 GHz-only APs.

config LAB_WIFI_PSK
	string "Wi-Fi password"
	default "changeme"

# TASK 2 - declare LAB_BROKER_ADDR (string) and LAB_BROKER_PORT (int), following
# the style above. Guide section 1 gives the values and explains why the node now
# needs an address that the HTTP lab did not.

source "Kconfig.zephyr"

config LAB_BROKER_ADDR
	string "MQTT Broker IP Address"
	default "192.168.1.100"

config LAB_BROKER_PORT
	int "MQTT Broker Port"
	default 1883
```

## prj.conf
```kconfig
CONFIG_LOG=y
CONFIG_MAIN_STACK_SIZE=4096
# The default 768-byte log thread stack overflows once Wi-Fi and the
# protocol stack log together, and messages are silently dropped.
CONFIG_LOG_PROCESS_THREAD_STACK_SIZE=2048
CONFIG_LOG_BUFFER_SIZE=4096

# Networking
CONFIG_NETWORKING=y
CONFIG_NET_IPV4=y
CONFIG_NET_IPV6=n
CONFIG_NET_TCP=y
CONFIG_NET_SOCKETS=y
CONFIG_NET_DHCPV4=y
CONFIG_NET_MGMT=y
CONFIG_NET_MGMT_EVENT=y
CONFIG_NET_MGMT_EVENT_INFO=y
CONFIG_NET_CONFIG_SETTINGS=n
CONFIG_POSIX_API=y

# TASK 1 - the same four capability symbols as the HTTP lab, with one changed.
# Guide section 0 says which.
# Tarea 1: Subsistemas requeridos
CONFIG_WIFI=y
CONFIG_MQTT_LIB=y
CONFIG_JSON_LIBRARY=y
CONFIG_LED_STRIP=y

# Requisitos de Red e IP para MQTT
CONFIG_NETWORKING=y
CONFIG_NET_IPV4=y
CONFIG_NET_TCP=y
CONFIG_NET_SOCKETS=y

# Credenciales de Wi-Fi
CONFIG_LAB_WIFI_SSID="changeme"
CONFIG_LAB_WIFI_PSK="changeme"

# Tarea 2: Dirección y Puerto del Broker MQTT
CONFIG_LAB_BROKER_ADDR="192.168.1.7"
CONFIG_LAB_BROKER_PORT=1883
```

## mosquitto_snippet.conf
```kconfig
# Listener normal para el ESP32 (MQTT/TCP)
listener 1883
protocol mqtt

# Listener nuevo para el dashboard (MQTT sobre WebSocket)
listener 9001
protocol websockets

# Solo para el laboratorio; en producción configura autenticación real.
allow_anonymous true
```

## src/main.c
```c
/*
 * Lab 0 - Minimal IoT Implementation (MQTT)
 *
 * Sensing capability:   PUBLISH   iot/sensor  -> {"temperature": 24.5}
 * Actuating capability: SUBSCRIBE iot/control <- {"state": 0|1}
 *
 * Same two capabilities as the HTTP version, but the node is now a client that
 * connects outward to a broker instead of a server waiting to be polled.
 */

#include <zephyr/kernel.h>
#include <zephyr/device.h>
#include <zephyr/data/json.h>
#include <zephyr/drivers/led_strip.h>
#include <zephyr/net/mqtt.h>
#include <zephyr/net/net_event.h>
#include <zephyr/net/net_if.h>
#include <zephyr/net/net_mgmt.h>
#include <zephyr/net/socket.h>
#include <zephyr/net/wifi_mgmt.h>
#include <zephyr/random/random.h>
#include <zephyr/logging/log.h>

#if !defined(CONFIG_WIFI) || !defined(CONFIG_MQTT_LIB) || \
	!defined(CONFIG_JSON_LIBRARY) || !defined(CONFIG_LED_STRIP)
#error "TASK 1 is not done yet: add the four capability symbols to prj.conf. \
The lab guide lists them in section 0."
#endif

#if !defined(CONFIG_LAB_BROKER_ADDR)
#error "TASK 2 is not done yet: declare LAB_BROKER_ADDR and LAB_BROKER_PORT in Kconfig. \
The lab guide gives them in 'Point the node at your broker'."
#endif

LOG_MODULE_REGISTER(lab0_mqtt, LOG_LEVEL_INF);

#define TOPIC_SENSOR  "iot/sensor"
#define TOPIC_CONTROL "iot/control"

#define PUBLISH_INTERVAL K_SECONDS(2)

static const struct device *const strip = DEVICE_DT_GET(DT_ALIAS(led_strip));

static K_SEM_DEFINE(ipv4_ready, 0, 1);

static struct net_mgmt_event_callback wifi_cb;
static struct net_mgmt_event_callback ipv4_cb;

static struct mqtt_client client;
static struct sockaddr_storage broker;
static uint8_t rx_buffer[256];
static uint8_t tx_buffer[256];
static struct zsock_pollfd fds[1];
static bool connected;

/* --- Actuating capability ------------------------------------------------ */

struct control_cmd {
	int state;
};

static const struct json_obj_descr control_cmd_descr[] = {
	JSON_OBJ_DESCR_PRIM(struct control_cmd, state, JSON_TOK_NUMBER),
};

static void led_set(int on)
{
	struct led_rgb color = on ? (struct led_rgb){ .r = 0, .g = 32, .b = 0 }
				  : (struct led_rgb){ .r = 0, .g = 0, .b = 0 };

	led_strip_update_rgb(strip, &color, 1);
}

static void handle_control_payload(struct mqtt_client *c,
				   const struct mqtt_publish_param *pub)
{
	uint8_t payload[64];
	uint32_t len = pub->message.payload.len;
	struct control_cmd cmd = { 0 };
	int ret;

	if (len >= sizeof(payload)) {
		LOG_WRN("Control payload too large (%u bytes), dropping", len);
		return;
	}

	/* Leer los datos recibidos desde el socket MQTT */
	ret = mqtt_read_publish_payload(c, payload, len);
	if (ret < 0) {
		LOG_ERR("Error al leer payload MQTT (%d)", ret);
		return;
	}

	payload[len] = '\0';

	/* Parsear JSON y actualizar el estado del LED */
	ret = json_obj_parse((char *)payload, len, control_cmd_descr,
			     ARRAY_SIZE(control_cmd_descr), &cmd);
	if (ret >= 0) {
		led_set(cmd.state);
	}

	/* Enviar acuse de recibo si la publicación es QoS 1 */
	if (pub->message.topic.qos == MQTT_QOS_1_AT_LEAST_ONCE) {
		struct mqtt_puback_param param = {
			.message_id = pub->message_id
		};
		mqtt_publish_qos1_ack(c, &param);
	}
}

/* --- Sensing capability -------------------------------------------------- */

static int publish_sensor(struct mqtt_client *c)
{
	uint8_t payload[64];
	struct mqtt_publish_param param = { 0 };
	uint32_t tenths = 200 + (sys_rand32_get() % 100);
	int len = snprintf(payload, sizeof(payload), "{\"temperature\": %u.%u}",
			   tenths / 10, tenths % 10);

	param.message.topic.topic.utf8 = (uint8_t *)TOPIC_SENSOR;
	param.message.topic.topic.size = strlen(TOPIC_SENSOR);
	param.message.topic.qos = MQTT_QOS_0_AT_MOST_ONCE;
	param.message.payload.data = payload;
	param.message.payload.len = len;
	param.message_id = sys_rand16_get();
	param.dup_flag = 0;
	param.retain_flag = 0;

	return mqtt_publish(c, &param);
}

static int subscribe_control(struct mqtt_client *c)
{
	struct mqtt_topic topic = {
		.topic = {
			.utf8 = (uint8_t *)TOPIC_CONTROL,
			.size = strlen(TOPIC_CONTROL),
		},
		.qos = MQTT_QOS_1_AT_LEAST_ONCE,
	};
	struct mqtt_subscription_list list = {
		.list = &topic,
		.list_count = 1,
		.message_id = sys_rand16_get(),
	};

	LOG_INF("Subscribing to %s", TOPIC_CONTROL);

	return mqtt_subscribe(c, &list);
}

static void mqtt_evt_handler(struct mqtt_client *const c, const struct mqtt_evt *evt)
{
	switch (evt->type) {
	case MQTT_EVT_CONNACK:
		if (evt->result != 0) {
			LOG_ERR("MQTT connect failed (%d)", evt->result);
			break;
		}
		connected = true;
		LOG_INF("Connected to broker");
		subscribe_control(c);
		break;

	case MQTT_EVT_DISCONNECT:
		LOG_INF("Disconnected from broker (%d)", evt->result);
		connected = false;
		break;

	case MQTT_EVT_PUBLISH:
		handle_control_payload(c, &evt->param.publish);
		break;

	case MQTT_EVT_SUBACK:
		LOG_INF("Subscribed to %s", TOPIC_CONTROL);
		break;

	default:
		break;
	}
}

static void broker_init(void)
{
	struct sockaddr_in *b = (struct sockaddr_in *)&broker;

	b->sin_family = AF_INET;
	b->sin_port = htons(CONFIG_LAB_BROKER_PORT);
	zsock_inet_pton(AF_INET, CONFIG_LAB_BROKER_ADDR, &b->sin_addr);
}

static void client_init(struct mqtt_client *c)
{
	static const char client_id[] = "esp32c6-node";

	mqtt_client_init(c);
	broker_init();

	c->broker = &broker;
	c->evt_cb = mqtt_evt_handler;
	c->client_id.utf8 = (uint8_t *)client_id;
	c->client_id.size = strlen(client_id);
	c->password = NULL;
	c->user_name = NULL;
	c->protocol_version = MQTT_VERSION_3_1_1;
	c->transport.type = MQTT_TRANSPORT_NON_SECURE;

	c->rx_buf = rx_buffer;
	c->rx_buf_size = sizeof(rx_buffer);
	c->tx_buf = tx_buffer;
	c->tx_buf_size = sizeof(tx_buffer);
}

/* --- Interface capability: join the Wi-Fi network ------------------------ */

static void wifi_event_handler(struct net_mgmt_event_callback *cb, uint64_t event,
			       struct net_if *iface)
{
	const struct wifi_status *st = (const struct wifi_status *)cb->info;

	if (event == NET_EVENT_WIFI_CONNECT_RESULT) {
		if (st->status) {
			LOG_ERR("Wi-Fi association failed (%d)", st->status);
		} else {
			LOG_INF("Associated with \"%s\"", CONFIG_LAB_WIFI_SSID);
		}
	} else if (event == NET_EVENT_WIFI_DISCONNECT_RESULT) {
		LOG_WRN("Wi-Fi disconnected");
	}
}

static void ipv4_event_handler(struct net_mgmt_event_callback *cb, uint64_t event,
			       struct net_if *iface)
{
	if (event != NET_EVENT_IPV4_ADDR_ADD) {
		return;
	}

	for (int i = 0; i < NET_IF_MAX_IPV4_ADDR; i++) {
		char buf[NET_IPV4_ADDR_LEN];

		if (iface->config.ip.ipv4->unicast[i].ipv4.addr_type != NET_ADDR_DHCP) {
			continue;
		}

		LOG_INF("IPv4 address: %s",
			net_addr_ntop(AF_INET,
				      &iface->config.ip.ipv4->unicast[i].ipv4.address.in_addr,
				      buf, sizeof(buf)));
		k_sem_give(&ipv4_ready);
	}
}

static int wifi_connect(void)
{
	struct net_if *iface = net_if_get_first_wifi();
	struct wifi_connect_req_params params = { 0 };

	if (iface == NULL) {
		LOG_ERR("No Wi-Fi interface found");
		return -ENODEV;
	}

	params.ssid = (const uint8_t *)CONFIG_LAB_WIFI_SSID;
	params.ssid_length = strlen(CONFIG_LAB_WIFI_SSID);
	params.psk = (const uint8_t *)CONFIG_LAB_WIFI_PSK;
	params.psk_length = strlen(CONFIG_LAB_WIFI_PSK);
	params.security = WIFI_SECURITY_TYPE_PSK;
	params.channel = WIFI_CHANNEL_ANY;
	params.band = WIFI_FREQ_BAND_2_4_GHZ;
	params.mfp = WIFI_MFP_OPTIONAL;

	LOG_INF("Connecting to \"%s\"...", CONFIG_LAB_WIFI_SSID);

	return net_mgmt(NET_REQUEST_WIFI_CONNECT, iface, &params, sizeof(params));
}

int main(void)
{
	int64_t next_publish;
	int rc;

	if (!device_is_ready(strip)) {
		LOG_ERR("LED strip device not ready");
		return -ENODEV;
	}
	led_set(0);

	net_mgmt_init_event_callback(&wifi_cb, wifi_event_handler,
				     NET_EVENT_WIFI_CONNECT_RESULT |
					     NET_EVENT_WIFI_DISCONNECT_RESULT);
	net_mgmt_add_event_callback(&wifi_cb);

	net_mgmt_init_event_callback(&ipv4_cb, ipv4_event_handler, NET_EVENT_IPV4_ADDR_ADD);
	net_mgmt_add_event_callback(&ipv4_cb);

	if (wifi_connect() != 0) {
		LOG_ERR("Wi-Fi connect request failed");
		return -EIO;
	}

	k_sem_take(&ipv4_ready, K_FOREVER);

	while (1) {
		client_init(&client);

		LOG_INF("Connecting to broker %s:%d", CONFIG_LAB_BROKER_ADDR,
			CONFIG_LAB_BROKER_PORT);

		rc = mqtt_connect(&client);
		if (rc != 0) {
			LOG_ERR("mqtt_connect failed (%d), retrying in 5s", rc);
			k_sleep(K_SECONDS(5));
			continue;
		}

		fds[0].fd = client.transport.tcp.sock;
		fds[0].events = ZSOCK_POLLIN;

		next_publish = k_uptime_get() + 2000;

		while (1) {
			int timeout = mqtt_keepalive_time_left(&client);
			int wait = MIN(timeout, 1000);

			rc = zsock_poll(fds, 1, wait);
			if (rc < 0) {
				LOG_ERR("poll failed (%d)", errno);
				break;
			}

			if (rc > 0 && (fds[0].revents & ZSOCK_POLLIN)) {
				rc = mqtt_input(&client);
				if (rc != 0) {
					LOG_ERR("mqtt_input failed (%d)", rc);
					break;
				}
			}

			if (fds[0].revents & (ZSOCK_POLLERR | ZSOCK_POLLHUP)) {
				LOG_ERR("Broker connection lost");
				break;
			}

			rc = mqtt_live(&client);
			if (rc != 0 && rc != -EAGAIN) {
				LOG_ERR("mqtt_live failed (%d)", rc);
				break;
			}

			if (connected && k_uptime_get() >= next_publish) {
				publish_sensor(&client);
				next_publish = k_uptime_get() + 2000;
			}
		}

		connected = false;
		mqtt_disconnect(&client, NULL);
		k_sleep(K_SECONDS(5));
	}

	return 0;
}
```
