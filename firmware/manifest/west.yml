## firmware/manifest/west.yml
```yaml
manifest:
  remotes:
    - name: zephyrproject
      url-base: https://github.com/zephyrproject-rtos
  projects:
    - name: zephyr
      repo-path: zephyr
      remote: zephyrproject
      import:
        path-prefix: deps
        name-allowlist:
          - cmsis_6
          - percepio
          - picolibc
          - mcuboot
          - trusted-firmware-m
          - segger
          - mbedtls
          - tf-psa-crypto
          - hal_espressif
          - hal_xtensa
          - openthread
          - zcbor
          - mldsa-native
      revision: 2f0bc11264a8e72e214f3db0a3fa221eb022453a  # commit fijado por el curso (SDK 1.0.1)
  self:
    path: manifest
```
